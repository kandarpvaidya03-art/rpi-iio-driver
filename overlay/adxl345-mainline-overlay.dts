/dts-v1/;
/plugin/;

/ {
    compatible = "brcm,bcm2712";

    fragment@0 {
        target = <&i2c_arm>;
        __overlay__ {
            adxl345_mainline: adxl345@53 {
                compatible = "adi,adxl345";
                reg = <0x53>;
                interrupt-parent = <&gpio>;
                interrupts = <17 4>;
                interrupt-names = "INT1";
            };
        };
    };
};
