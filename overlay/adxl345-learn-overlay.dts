/dts-v1/;
/plugin/;

/ {
    compatible = "brcm,bcm2712";

    fragment@0 {
        target = <&i2c_arm>;
        __overlay__ {
            adxl345_learn: adxl345@53 {
                compatible = "rpi,adxl345-learn";
                reg = <0x53>;
                interrupt-parent = <&gpio>;
                interrupts = <17 4>;
            };
        };
    };
};
